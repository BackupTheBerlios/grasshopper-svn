## trunk/base/package/alsa/Config.in
```kconfig
menuconfig BR2_PACKAGE_ALSA
	bool "ALSA"
	default n
	help
		Using the Advanced Linux Sound Architecture

if BR2_PACKAGE_ALSA
source package/alsa/driver/Config.in
source package/alsa-lib/Config.in
source package/alsa/lib-plugin/Config.in
source package/alsa/tools/Config.in
source package/alsa-utils/Config.in
endif
```

## trunk/base/package/fbv/Config.in
```kconfig
config BR2_PACKAGE_FBV
	bool "FrameBuffer Viewer"
	default n
	select BR2_PACKAGE_FBSET
	select BR2_PACKAGE_LIBPNG
	select BR2_PACKAGE_JPEG
	help
	  Excellent image file viewer.
```

## trunk/base/package/kaffe/Config.in
```kconfig
config BR2_PACKAGE_KAFFE
	bool "kaffe"
	default n
	help
		A small, free Java Virtual Machine.

choice 
	prompt "  Engine"
	depends on BR2_PACKAGE_KAFFE
	default BR2_KAFFE_ENG_AUTO
	help
		Which Engine Kaffe should use

config BR2_KAFFE_ENG_AUTO
	bool "auto"
	help
		Don not depend on a specific engine

config BR2_KAFFE_ENG_INTRP
	bool "intrp"

config BR2_KAFFE_ENG_JIT
	bool "jit"

config BR2_KAFFE_ENG_JIT3
	bool "jit3"

endchoice

config BR2_KAFFE_ENGINE
	depends on BR2_PACKAGE_KAFFE
	string
	default "intrp"	if BR2_KAFFE_ENG_INTRP
	default "jit"	if BR2_KAFFE_ENG_JIT
	default "jit3"	if BR2_KAFFE_ENG_JIT3

config BR2_KAFFE_AWT
	bool "  AWT"
	depends on BR2_PACKAGE_KAFFE
	default y
	help
		The Abstract Windowing Toolkit
		A GUI-Toolkit

config BR2_KAFFE_AWT_X
	bool "    Xlib-based AWT Engine"
	depends on BR2_KAFFE_AWT && ( BR2_PACKAGE_XORG || BR2_PACKAGE_TINYX)
	default y

config BR2_KAFFE_AWT_QT
	bool "    qt-based AWT Engine"
	depends on BR2_KAFFE_AWT && ( BR2_PACKAGE_QTE || BR2_PACKAGE_QTOPIA4 )
	default y

config BR2_KAFFE_SOUND
	depends on BR2_PACKAGE_KAFFE
	default y
	bool "  sound"
	help
		make Kaffe to use your Soundcard

config BR2_KAFFE_JNI
	depends on BR2_PACKAGE_KAFFE
	default y
	bool "  JNI"
```

## trunk/base/package/libvorbis/Config.in
```kconfig
config BR2_PACKAGE_LIBVORBIS
	bool "libvorbis"
	default n
	help
		Library for Playing Ogg/Vorbis-Coded Music
```

## trunk/base/package/sawman/Config.in
```kconfig
config BR2_PACKAGE_SAWMAN
	bool "SawMan"
	default y
	select BR2_PACKAGE_DIRECTFB
	select BR2_DIRECTFB_MULTI
	help
		A multi-Application Window-Manager for DirectFB
```

## trunk/base/target/u-boot/Config.in
```kconfig
config BR2_TARGET_UBOOT
	bool "U-Boot"
	depends on !BR2_TARGET_GRUB && !BR2_TARGET_SYSLINUX && !BR2_TARGET_YABOOT
	help
		Use "Das U-Boot" as Bootloader.

choice 
	prompt "U-Boot Version"
	depends on BR2_TARGET_UBOOT
	default BR2_UBOOT_1_1_4
	help
		Select the Version of U-Boot you wish to use

	config BR2_UBOOT_1_1_4
		bool "1.1.4"

	config BR2_UBOOT_1_1_6
		bool "1.1.6"

	config BR2_UBOOT_1_3_0
		bool "1.3.0"

endchoice

config UBOOT_VERSION
	string
	default 1.1.4 if BR2_UBOOT_1_1_4
	default 1.1.6 if BR2_UBOOT_1_1_6
	default 1.3.0 if BR2_UBOOT_1_3_0

config BR2_UBOOT_BOARD
	string
	default icnova_base if BR2_BOARD_ICNOVA_BASE
	default icnova_base_cp2102 if BOARD_ICNOVA_BASE_CP2102
	default icnova_lcd if BR2_BOARD_ICNOVA_VGA
	default atstk1002 if BR2_BOARD_STK1000
	default at91rm9200dk if BR2_TARGET_ARM_CARMEVA
	# TODO add valid config for ICNOVA_VGA and _MAC
```

## trunk/linux_toolchain_base/package/alsa-lib/Config.in
```kconfig
config BR2_PACKAGE_ALSA_LIB
	bool "ALSA library"
	default n
	help
		The ALSA library with the standard plugins
```

## trunk/linux_toolchain_base/package/alsa-utils/Config.in
```kconfig
config BR2_PACKAGE_ALSA_UTILS
	bool "ALSA utils"
	default n
	help
		Tools for configuring and using ALSA

		amixer: command line mixer
		alsamixer: curses mixer
		amidi: read from and write to ALSA RawMIDI ports
		aplay, arecord: command line playback and recording
		aplaymidi, arecordmidi: command line MIDI playback and recording
		aconnect, aseqnet, aseqdump: command line MIDI sequencer control
```

## trunk/linux_toolchain_base/package/alsa/driver/Config.in
```kconfig
config BR2_PACKAGE_ALSA_DRIVER
	bool "ALSA driver"
	default n
	help
		Additional Soundcard-Drivers for ALSA
```

## trunk/linux_toolchain_base/package/alsa/lib-plugin/Config.in
```kconfig
config BR2_PACKAGE_ALSA_LIB_PLUGINS
	bool "additional ALSA Library Plugins"
	default n
```

## trunk/linux_toolchain_base/package/alsa/tools/Config.in
```kconfig
config BR2_PACKAGE_ALSA_TOOLS
	bool "ALSA tools"
	default n
	help
		Some Tools for specific Sound-Hardware

		us428control - Controller utility for Tascam US-X2Y
		sbiload - OPL2/3 FM instrument loader for the ALSA sequencer
		as10k1 - An assembler for the EMU10K1 (EMU10K2) DSP chip
		ac3dec - A free AC-3 stream decoder                                            
		omixer - control tool for Echoaudio soundcards
		envy24control - control tool for Envy24 (ice1712) based 
			soundcards
		hdspconf - GUI program to control the Hammerfall HDSP Alsa 
			Settings.
		hdspmixer - tool to control the advanced routing features of the			RME Hammerfall DSP.
		rmedigicontrol - control tool for RME Digi32 and RME Digi96
			soundcards
```

## trunk/linux_toolchain_base/package/directfb/Config.in
```kconfig
config BR2_PACKAGE_DIRECTFB
	bool "directfb"
	default n
	select BR2_PACKAGE_ZLIB
	select BR2_PACKAGE_JPEG
	select BR2_PACKAGE_LIBPNG
	select BR2_PACKAGE_LIBSYSFS
	select BR2_PACKAGE_FREETYPE
	help

	http://www.directfb.org/

config BR2_DIRECTFB_FUSION
	bool "  fusion"
	default n
	depends on BR2_PACKAGE_DIRECTFB
	help
		Enable DirectFB-Fusion Support

config BR2_DIRECTFB_MULTI
	bool "  Multi Application Core"
	default n
	depends on BR2_PACKAGE_DIRECTFB
	select BR2_DIRECTFB_FUSION
```

## trunk/linux_toolchain_base/package/fusionsound/Config.in
```kconfig
config BR2_PACKAGE_FUSIONSOUND
	bool "Fusion-Sound"
	default n
	select BR2_PACKAGE_DIRECTFB
	select BR2_DIRECTFB_FUSION
	select BR2_PACKAGE_LIBVORBIS
	help
		The Fusion-Sound Modul of DirectFB
```

## trunk/linux_toolchain_base/package/icnova-demo/Config.in
```kconfig
config BR2_PACKAGE_DEMO
	bool "ICnova Demo"
	default n
	help
	  Some Code-Examples to show the basic usage of the board.
```

## trunk/linux_toolchain_base/package/rs232_proxy/Config.in
```kconfig
config BR2_PACKAGE_RS232PROXY
	bool "rs232_proxy"
	default n
	help
		gets 802.15.4 Packeages over rs232 and sends them to all 
		connected network clients.
```

## trunk/linux_toolchain_base/target/device/Atmel/Config.in
```kconfig
menu "Atmel Target"
	depends on BR2_arm || BR2_avr32

config BR2_BOARD_STK1000
	bool "STK1000"
	depends on BR2_avr32
	default n
	select BR2_PACKAGE_LINUX
	select BR2_PTHREADS
	help
		An STK1000 Development-Board from ATMEL

config BR2_TARGET_ARM_CARMEVA
	bool "Conitec ARM/EVA"
	depends BR2_arm
	default n
	select BR2_PACKAGE_LINUX
	select BR2_ARM_OABI
	select BR2_KERNEL_HEADERS_2_6_15
	select BR2_PTHREADS
	select BR2_arm920t
	help
		The Arm/Eva board from Conitec based on an Atmel AT91RM9200

endmenu
```

## trunk/linux_toolchain_base/target/device/In-Circuit/Config.in
```kconfig
config BR2_BOARD_ICNOVA
	bool "ICNova support"
	depends on BR2_avr32
	default n
	select BR2_PACKAGE_LINUX
	select BR2_PTHREADS_OLD
	help
	  One of the ICNova-boards build by In-Circuit

choice
	prompt "Board type"
	depends on BR2_BOARD_ICNOVA
	default BR2_BOARD_ICNOVA_BASE

config BR2_BOARD_ICNOVA_MAC
	bool "ICnova with two Ethernet Ports"

config BR2_BOARD_ICNOVA_VGA
	bool "ICNova with VGA-Port"

config BR2_BOARD_ICNOVA_BASE
	bool "ICNova Base"

endchoice

config BR2_BOARD_ICNOVA_CP2102
	depends on BR2_BOARD_ICNOVA_BASE
	bool "Board has a CP2102"
```
